## serv_project/build/Kconfig/Kconfig.modules
```kconfig
menu "serv (/home/chenyoo/servWorkspace/fusesoc_libraries/serv)"
osource "/home/chenyoo/servWorkspace/fusesoc_libraries/serv/zephyr/Kconfig"
config ZEPHYR_SERV_MODULE
	bool
	default y
endmenu
menu "acpica (/home/chenyoo/servWorkspace/modules/lib/acpica)"
osource "$(ZEPHYR_ACPICA_KCONFIG)"
config ZEPHYR_ACPICA_MODULE
	bool
	default y
endmenu
menu "cmsis (/home/chenyoo/servWorkspace/modules/hal/cmsis)"
osource "$(ZEPHYR_CMSIS_KCONFIG)"
config ZEPHYR_CMSIS_MODULE
	bool
	default y
endmenu
menu "cmsis-dsp (/home/chenyoo/servWorkspace/modules/lib/cmsis-dsp)"
osource "$(ZEPHYR_CMSIS_DSP_KCONFIG)"
config ZEPHYR_CMSIS_DSP_MODULE
	bool
	default y
endmenu
menu "cmsis-nn (/home/chenyoo/servWorkspace/modules/lib/cmsis-nn)"
osource "$(ZEPHYR_CMSIS_NN_KCONFIG)"
config ZEPHYR_CMSIS_NN_MODULE
	bool
	default y
endmenu
menu "fatfs (/home/chenyoo/servWorkspace/modules/fs/fatfs)"
osource "$(ZEPHYR_FATFS_KCONFIG)"
config ZEPHYR_FATFS_MODULE
	bool
	default y
endmenu
config ZEPHYR_ADI_MODULE
	bool
	default y
config ZEPHYR_ALTERA_MODULE
	bool
	default y
menu "hal_ambiq (/home/chenyoo/servWorkspace/modules/hal/ambiq)"
osource "$(ZEPHYR_HAL_AMBIQ_KCONFIG)"
config ZEPHYR_HAL_AMBIQ_MODULE
	bool
	default y
endmenu
config ZEPHYR_ATMEL_MODULE
	bool
	default y
menu "hal_espressif (/home/chenyoo/servWorkspace/modules/hal/espressif)"
osource "/home/chenyoo/servWorkspace/modules/hal/espressif/zephyr/Kconfig"
config ZEPHYR_HAL_ESPRESSIF_MODULE
	bool
	default y

config ZEPHYR_HAL_ESPRESSIF_MODULE_BLOBS
	bool
endmenu
menu "hal_ethos_u (/home/chenyoo/servWorkspace/modules/hal/ethos_u)"
osource "$(ZEPHYR_HAL_ETHOS_U_KCONFIG)"
config ZEPHYR_HAL_ETHOS_U_MODULE
	bool
	default y
endmenu
menu "hal_gigadevice (/home/chenyoo/servWorkspace/modules/hal/gigadevice)"
osource "$(ZEPHYR_HAL_GIGADEVICE_KCONFIG)"
config ZEPHYR_HAL_GIGADEVICE_MODULE
	bool
	default y
endmenu
menu "hal_infineon (/home/chenyoo/servWorkspace/modules/hal/infineon)"
osource "$(ZEPHYR_HAL_INFINEON_KCONFIG)"
config ZEPHYR_HAL_INFINEON_MODULE
	bool
	default y

config ZEPHYR_HAL_INFINEON_MODULE_BLOBS
	bool
endmenu
menu "hal_intel (/home/chenyoo/servWorkspace/modules/hal/intel)"
osource "/home/chenyoo/servWorkspace/modules/hal/intel/zephyr/Kconfig"
config ZEPHYR_HAL_INTEL_MODULE
	bool
	default y
endmenu
config ZEPHYR_MICROCHIP_MODULE
	bool
	default y
menu "hal_nordic (/home/chenyoo/servWorkspace/modules/hal/nordic)"
osource "$(ZEPHYR_HAL_NORDIC_KCONFIG)"
config ZEPHYR_HAL_NORDIC_MODULE
	bool
	default y

config ZEPHYR_HAL_NORDIC_MODULE_BLOBS
	bool
endmenu
config ZEPHYR_NUVOTON_MODULE
	bool
	default y
menu "hal_nxp (/home/chenyoo/servWorkspace/modules/hal/nxp)"
osource "$(ZEPHYR_HAL_NXP_KCONFIG)"
config ZEPHYR_HAL_NXP_MODULE
	bool
	default y

config ZEPHYR_HAL_NXP_MODULE_BLOBS
	bool
endmenu
config ZEPHYR_OPENISA_MODULE
	bool
	default y
config ZEPHYR_QUICKLOGIC_MODULE
	bool
	default y
config ZEPHYR_HAL_RENESAS_MODULE
	bool
	default y

config ZEPHYR_HAL_RENESAS_MODULE_BLOBS
	bool
menu "hal_rpi_pico (/home/chenyoo/servWorkspace/modules/hal/rpi_pico)"
osource "$(ZEPHYR_HAL_RPI_PICO_KCONFIG)"
config ZEPHYR_HAL_RPI_PICO_MODULE
	bool
	default y
endmenu
menu "hal_silabs (/home/chenyoo/servWorkspace/modules/hal/silabs)"
osource "$(ZEPHYR_HAL_SILABS_KCONFIG)"
config ZEPHYR_HAL_SILABS_MODULE
	bool
	default y

config ZEPHYR_HAL_SILABS_MODULE_BLOBS
	bool
endmenu
menu "hal_st (/home/chenyoo/servWorkspace/modules/hal/st)"
osource "$(ZEPHYR_HAL_ST_KCONFIG)"
config ZEPHYR_HAL_ST_MODULE
	bool
	default y
endmenu
config ZEPHYR_HAL_STM32_MODULE
	bool
	default y

config ZEPHYR_HAL_STM32_MODULE_BLOBS
	bool
menu "hal_telink (/home/chenyoo/servWorkspace/modules/hal/telink)"
osource "/home/chenyoo/servWorkspace/modules/hal/telink/Kconfig"
config ZEPHYR_HAL_TELINK_MODULE
	bool
	default y
endmenu
config ZEPHYR_TI_MODULE
	bool
	default y
config ZEPHYR_HAL_WURTHELEKTRONIK_MODULE
	bool
	default y
config ZEPHYR_XTENSA_MODULE
	bool
	default y
menu "hostap (/home/chenyoo/servWorkspace/modules/lib/hostap)"
osource "$(ZEPHYR_HOSTAP_KCONFIG)"
config ZEPHYR_HOSTAP_MODULE
	bool
	default y
endmenu
config ZEPHYR_LIBMETAL_MODULE
	bool
	default y
menu "liblc3 (/home/chenyoo/servWorkspace/modules/lib/liblc3)"
osource "$(ZEPHYR_LIBLC3_KCONFIG)"
config ZEPHYR_LIBLC3_MODULE
	bool
	default y
endmenu
menu "littlefs (/home/chenyoo/servWorkspace/modules/fs/littlefs)"
osource "$(ZEPHYR_LITTLEFS_KCONFIG)"
config ZEPHYR_LITTLEFS_MODULE
	bool
	default y
endmenu
menu "loramac-node (/home/chenyoo/servWorkspace/modules/lib/loramac-node)"
osource "$(ZEPHYR_LORAMAC_NODE_KCONFIG)"
config ZEPHYR_LORAMAC_NODE_MODULE
	bool
	default y
endmenu
menu "lvgl (/home/chenyoo/servWorkspace/modules/lib/gui/lvgl)"
osource "/home/chenyoo/servWorkspace/modules/lib/gui/lvgl/Kconfig"
config ZEPHYR_LVGL_MODULE
	bool
	default y
endmenu
menu "mbedtls (/home/chenyoo/servWorkspace/modules/crypto/mbedtls)"
osource "$(ZEPHYR_MBEDTLS_KCONFIG)"
config ZEPHYR_MBEDTLS_MODULE
	bool
	default y
endmenu
config ZEPHYR_MCUBOOT_MODULE
	bool
	default y
config ZEPHYR_MIPI_SYS_T_MODULE
	bool
	default y
config ZEPHYR_NRF_HW_MODELS_MODULE
	bool
	default y
config ZEPHYR_OPEN_AMP_MODULE
	bool
	default y
menu "openthread (/home/chenyoo/servWorkspace/modules/lib/openthread)"
osource "$(ZEPHYR_OPENTHREAD_KCONFIG)"
config ZEPHYR_OPENTHREAD_MODULE
	bool
	default y
endmenu
menu "percepio (/home/chenyoo/servWorkspace/modules/debug/percepio)"
osource "/home/chenyoo/servWorkspace/modules/debug/percepio/zephyr/Kconfig"
config ZEPHYR_PERCEPIO_MODULE
	bool
	default y
endmenu
menu "picolibc (/home/chenyoo/servWorkspace/modules/lib/picolibc)"
osource "/home/chenyoo/servWorkspace/modules/lib/picolibc/zephyr/Kconfig"
config ZEPHYR_PICOLIBC_MODULE
	bool
	default y
endmenu
menu "segger (/home/chenyoo/servWorkspace/modules/debug/segger)"
osource "$(ZEPHYR_SEGGER_KCONFIG)"
config ZEPHYR_SEGGER_MODULE
	bool
	default y
endmenu
config ZEPHYR_TINYCRYPT_MODULE
	bool
	default y
menu "trusted-firmware-m (/home/chenyoo/servWorkspace/modules/tee/tf-m/trusted-firmware-m)"
osource "$(ZEPHYR_TRUSTED_FIRMWARE_M_KCONFIG)"
config ZEPHYR_TRUSTED_FIRMWARE_M_MODULE
	bool
	default y
endmenu
menu "trusted-firmware-a (/home/chenyoo/servWorkspace/modules/tee/tf-a/trusted-firmware-a)"
osource "$(ZEPHYR_TRUSTED_FIRMWARE_A_KCONFIG)"
config ZEPHYR_TRUSTED_FIRMWARE_A_MODULE
	bool
	default y
endmenu
menu "uoscore-uedhoc (/home/chenyoo/servWorkspace/modules/lib/uoscore-uedhoc)"
osource "$(ZEPHYR_UOSCORE_UEDHOC_KCONFIG)"
config ZEPHYR_UOSCORE_UEDHOC_MODULE
	bool
	default y
endmenu
menu "zcbor (/home/chenyoo/servWorkspace/modules/lib/zcbor)"
osource "$(ZEPHYR_ZCBOR_KCONFIG)"
config ZEPHYR_ZCBOR_MODULE
	bool
	default y
endmenu
```

## serv_project/build/Kconfig/Kconfig.shield
```kconfig
osource "/home/chenyoo/servWorkspace/fusesoc_libraries/serv/zephyr/boards/shields/*/Kconfig.shield"
osource "/home/chenyoo/servWorkspace/fusesoc_libraries/serv/zephyr/boards/shields/*/Kconfig.shield"
```

## serv_project/build/Kconfig/Kconfig.shield.defconfig
```kconfig
osource "/home/chenyoo/servWorkspace/fusesoc_libraries/serv/zephyr/boards/shields/*/Kconfig.defconfig"
osource "/home/chenyoo/servWorkspace/fusesoc_libraries/serv/zephyr/boards/shields/*/Kconfig.defconfig"
```

## serv_project/build/Kconfig/soc/Kconfig.defconfig
```kconfig
osource "/home/chenyoo/servWorkspace/fusesoc_libraries/serv/zephyr/soc/$(ARCH)/*/Kconfig.defconfig"
```

## serv_project/build/Kconfig/soc/Kconfig.soc.arch
```kconfig
osource "/home/chenyoo/servWorkspace/fusesoc_libraries/serv/zephyr/soc/$(ARCH)/Kconfig"
osource "/home/chenyoo/servWorkspace/fusesoc_libraries/serv/zephyr/soc/$(ARCH)/*/Kconfig"
```

## serv_project/build/Kconfig/soc/Kconfig.soc.choice
```kconfig
osource "/home/chenyoo/servWorkspace/fusesoc_libraries/serv/zephyr/soc/$(ARCH)/*/Kconfig.soc"
```
